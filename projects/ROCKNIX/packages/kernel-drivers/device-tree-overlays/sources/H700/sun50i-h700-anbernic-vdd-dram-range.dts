/dts-v1/;
/plugin/;

/*
 * Leave vdd-dram at the voltage u-boot set for the detected DRAM type:
 * 1.1V for LPDDR4, 1.2V for LPDDR3.
 */
/ {
	fragment@0 {
		target = <&reg_dcdc3>;
		__overlay__ {
			regulator-min-microvolt = <1100000>;
			regulator-max-microvolt = <1200000>;
		};
	};
};
